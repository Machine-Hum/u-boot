## configs/lindenis_v5_defconfig
```kconfig
CONFIG_ARM=y
CONFIG_ARCH_SUNXI=y
CONFIG_DEFAULT_DEVICE_TREE="sun50i-h6-pine-h64"
CONFIG_SPL=y
CONFIG_MACH_SUN8I_V5=y
CONFIG_SUNXI_DRAM_H6_LPDDR3=y
CONFIG_SPL_SPI_SUNXI=y
CONFIG_MMC0_CD_PIN="PF6"
# CONFIG_SYS_MALLOC_CLEAR_ON_INIT is not set
CONFIG_USB_EHCI_HCD=y
CONFIG_USB_OHCI_HCD=y
```
